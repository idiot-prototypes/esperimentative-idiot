## Kconfig
```kconfig
# SPDX-License-Identifier: Apache-2.0

menu "Drivers"
rsource "drivers/Kconfig"
endmenu

menu "Subsystems and OS Services"
rsource "subsys/fs/Kconfig"
endmenu
```

## drivers/sensor/Kconfig
```kconfig
# SPDX-License-Identifier: Apache-2.0

if SENSOR
rsource "bh1750/Kconfig"
rsource "htu21d/Kconfig"
endif # SENSOR
```

## drivers/sensor/bh1750/Kconfig
```kconfig
# BH1750 temperature and pressure sensor configuration options

# Copyright (c) 2022 Gaël PORTAY
# SPDX-License-Identifier: Apache-2.0

menuconfig BH1750
	bool "BH1750 sensor"
	default y
	depends on DT_HAS_ROHM_BH1750_ENABLED
	select I2C
	help
	  Enable driver for BH1750 I2C-based light sensor.

if BH1750

choice
	prompt "BH1750 mode"
	default BH1750_CONTINUOUSLY_HIGH_RESOLUTION_MODE
	help
	  Select mode. In continuously mode continuous measurements are
	  performed, whereas in one-time mode only single measurement is
	  performed and chip is automatically power down after measurement.
config BH1750_CONTINUOUSLY_HIGH_RESOLUTION_MODE
	bool "continuously high resolution (1lx, 120ms)"
config BH1750_CONTINUOUSLY_HIGH_RESOLUTION_MODE_2
	bool "continuously high resolution 2 (0.5lx, 120ms)"
config BH1750_CONTINUOUSLY_LOW_RESOLUTION_MODE
	bool "continuously low resolution (4lx, 16ms)"
config BH1750_ONE_TIME_HIGH_RESOLUTION_MODE
	bool "one-time high resolution (1lx, 120ms)"
config BH1750_ONE_TIME_HIGH_RESOLUTION_MODE_2
	bool "one-time high resolution (0.5lx, 120ms)"
config BH1750_ONE_TIME_LOW_RESOLUTION_MODE
	bool "one-time low resolution (4lx, 16ms)"
endchoice

endif # BH1750
```

## drivers/sensor/htu21d/Kconfig
```kconfig
# HTU21D humidity and temperature sensor configuration options

# Copyright (c) 2022 Gaël PORTAY
# SPDX-License-Identifier: Apache-2.0

menuconfig HTU21D
	bool "HTU21D sensor"
	default y
	depends on DT_HAS_MEAS_HTU21D_ENABLED
	select I2C
	help
	  Enable driver for HTU21D I2C-based light sensor.
```

## dts/bindings/sensor/meas,htu21d-i2c.yaml
```yaml
# SPDX-License-Identifier: Apache-2.0

description: TE Connectivity integrated humidity and temperature sensor

compatible: "meas,htu21d"

include: i2c-device.yaml
```

## dts/bindings/sensor/rohm,bh1750-i2c.yaml
```yaml
# SPDX-License-Identifier: Apache-2.0

description: ROHM integrated light sensor

compatible: "rohm,bh1750"

include: i2c-device.yaml
```

## samples/sensor/bh1750/sample.yaml
```yaml
sample:
  name: BH1750 Sensor sample
tests:
  sample.sensor.bh1750:
    harness: console
    tags: sensors
    platform_allow: esp32
    harness_config:
        type: one_line
        regex:
            - "light: (.*)"
        fixture: fixture_i2c_bh1750
```

## subsys/Kconfig
```kconfig
# SPDX-License-Identifier: Apache-2.0

menu "Sub Systems and OS Services"
rsource "bluetooth/Kconfig"
endmenu
```

## subsys/bluetooth/Kconfig
```kconfig
# SPDX-License-Identifier: Apache-2.0

menu "Bluetooth"
rsource "services/Kconfig"
endmenu
```

## subsys/bluetooth/services/Kconfig
```kconfig
# SPDX-License-Identifier: Apache-2.0

menuconfig BT_WINC
	bool "GATT WINC service"
	help
	  Enable WINC Wi-Fi Scan and Connect Services as defined in the
	  Atmel ATWINC3400 user guide:

	  https://ww1.microchip.com/downloads/en/DeviceDoc/Atmel-42683-ATWINC3400-BLE-WiFi-Scan-and-Connect-Services-Guide_UserGuide.pdf

if BT_WINC

config BT_WINC_SETTINGS
	bool "Settings usage in WINC Service"
	select SETTINGS
	help
	  Enable Settings usage in WINC Service.

module = BT_WINC
module-str = WINC
source "subsys/logging/Kconfig.template.log_config"

endif # BT_WINC
```

## subsys/fs/fcb/Kconfig
```kconfig
# SPDX-License-Identifier: Apache-2.0

if FCB
config FCB_SHELL
	bool "FCB shell"
	depends on SHELL && FCB
	default y
	help
	  Enable the FCB shell with related commands such as next, last,
	  append, walk, rotate, clear...
endif # FCB
```
